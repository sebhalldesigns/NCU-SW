ASAP2_VERSION 1 71
/begin PROJECT MATLAB_UDP_Example "Minimal A2L compatible with XCP UDP Configuration block"
/begin HEADER "Test A2L for Simulink XCP UDP" /end HEADER
/begin MODULE ExampleModule "Demo Module"
/begin MOD_PAR "" VERSION "1.0" ADDR_EPK 0x00000000 EPK "EPK" /end MOD_PAR
/begin IF_DATA XCP
 /begin PROTOCOL_LAYER 0x0103 /* XCP protocol version 1.3 */ 0xFF /* Max CTO */ 0xFFFF /* Max DTO */ BYTE_ORDER_MSB_FIRST ADDRESS_GRANULARITY_BYTE /end PROTOCOL_LAYER
 /begin DAQ DYNAMIC MAX_DAQ 64 MAX_EVENT_CHANNEL 16 /begin TIMESTAMP_SUPPORTED TIMESTAMP_SIZE_4 TIMESTAMP_UNIT_1US /end TIMESTAMP_SUPPORTED /end DAQ
 /* === Critical section for XCP over UDP === */
 /begin XCP_ON_UDP_IP 0x0001 /* XCP on UDP/IP version */ 5005 /* UDP port number (change if your ECU uses different port) */ "192.168.1.50" /* ECU IP address - change to your actual ECU IP, e.g. "192.168.1.50" */ /end XCP_ON_UDP_IP
/end IF_DATA
/* At least one measurement so the block has something to show */
/begin MEASUREMENT EngineSpeed "Engine speed in rpm" VALUE UWORD CM_Rpm 0 0 0 8000 ECU_ADDRESS 0x20001000 /end MEASUREMENT
/begin COMPU_METHOD CM_Rpm "Linear" LINEAR "%8.0" 1 0 /end COMPU_METHOD
/end MODULE
/end PROJECT
