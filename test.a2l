ASAP2_VERSION 1 71
/begin PROJECT MATLAB_UDP_Example "Minimal A2L compatible with XCP UDP Configuration block"
/begin HEADER "Test A2L for Simulink XCP UDP" /end HEADER
/begin MODULE ExampleModule "Demo Module"
/begin MOD_PAR "" VERSION "1.0" ADDR_EPK 0x00000000 EPK "EPK" /end MOD_PAR
/begin IF_DATA XCP
 /begin PROTOCOL_LAYER 0x0103 /* XCP protocol version 1.3 */ 0xFF /* Max CTO */ 0xFFFF /* Max DTO */ BYTE_ORDER_MSB_FIRST ADDRESS_GRANULARITY_BYTE /end PROTOCOL_LAYER
 /begin DAQ DYNAMIC MAX_DAQ 64 MAX_EVENT_CHANNEL 16 /begin TIMESTAMP_SUPPORTED TIMESTAMP_SIZE_4 TIMESTAMP_UNIT_1US /end TIMESTAMP_SUPPORTED /end DAQ
 /* === Critical section for XCP over UDP === */
 /begin XCP_ON_UDP_IP 0x0001 /* XCP on UDP/IP version */ 5005 /* UDP port number (change if your ECU uses different port) */ "192.168.1.50" /* ECU IP address - change to your actual ECU IP, e.g. "192.168.1.50" */ /end XCP_ON_UDP_IP
/end IF_DATA
/begin CHARACTERISTIC bLedState /* Long Identifier */ "" /* Type */ VALUE /* ECU Address */ 0x10000004 /* Record Layout */ Record_BOOLEAN /* Maximum Difference */ 0 /* Conversion Method */ app_CM_logical /* Lower Limit */ 0 /* Upper Limit */ 1 /end CHARACTERISTIC
/begin MEASUREMENT bButtonState "" /* Data type */ UBYTE /* Conversion method */ app_CM_logical /* Resolution (Not used) */ 0 /* Accuracy (Not used) */ 0 /* Lower limit */ 0 /* Upper limit */ 1 ECU_ADDRESS 0x100001BC /end MEASUREMENT
/begin COMPU_METHOD /* Name of CompuMethod */ app_CM_logical "Q = V" /* Conversion Type */ IDENTICAL /* Format */ "%1.0" /* Units */ "" /end COMPU_METHOD
/begin RECORD_LAYOUT Record_BOOLEAN FNC_VALUES 1 UBYTE COLUMN_DIR DIRECT /end RECORD_LAYOUT
/begin GROUP app "app" /* Root */ ROOT /begin SUB_GROUP app_GPIO_Read app_GPIO_Write /end SUB_GROUP /begin REF_CHARACTERISTIC bLedState /end REF_CHARACTERISTIC /begin REF_MEASUREMENT bButtonState /end REF_MEASUREMENT /end GROUP
/begin GROUP app_GPIO_Read "app/GPIO Read" /begin REF_MEASUREMENT bButtonState /end REF_MEASUREMENT /end GROUP
/begin GROUP app_GPIO_Write "app/GPIO Write" /begin REF_MEASUREMENT bButtonState /end REF_MEASUREMENT /end GROUP
/end MODULE
/end PROJECT
