/* generated by ASAP2 Studio 20.0.10.42 */ ASAP2_VERSION 1 71
/begin PROJECT MATLAB_UDP_Example "Minimal A2L compatible with XCP UDP Configuration block"
/begin HEADER "Test A2L for Simulink XCP UDP" /end HEADER
/begin MODULE ExampleModule "Demo Module"
/begin MOD_PAR "" VERSION "1.0" ADDR_EPK 0x0 EPK "EPK" /end MOD_PAR
/begin MOD_COMMON "" ALIGNMENT_BYTE 1 ALIGNMENT_WORD 1 ALIGNMENT_LONG 1 ALIGNMENT_FLOAT16_IEEE 1 ALIGNMENT_FLOAT32_IEEE 1 ALIGNMENT_FLOAT64_IEEE 1 ALIGNMENT_INT64 1 /end MOD_COMMON
/begin IF_DATA XCP
 /begin PROTOCOL_LAYER 0x0105 0x07D0 0x2710 0x00 0x00 0x00 0x00 0x00 0x08 0x08 BYTE_ORDER_MSB_LAST ADDRESS_GRANULARITY_BYTE OPTIONAL_CMD DOWNLOAD OPTIONAL_CMD UPLOAD OPTIONAL_CMD SET_MTA /end PROTOCOL_LAYER
 /begin DAQ DYNAMIC 0x00 0x00 0x00 OPTIMISATION_TYPE_DEFAULT ADDRESS_EXTENSION_FREE IDENTIFICATION_FIELD_TYPE_RELATIVE_WORD_ALIGNED GRANULARITY_ODT_ENTRY_SIZE_DAQ_BYTE 0x04 OVERLOAD_INDICATION_EVENT PRESCALER_SUPPORTED /begin TIMESTAMP_SUPPORTED 0x01 SIZE_WORD UNIT_1MS /end TIMESTAMP_SUPPORTED /end DAQ
 /begin PAG 0x00 /end PAG
 /begin PGM PGM_MODE_ABSOLUTE 0x00 0x00 /end PGM
 /begin XCP_ON_UDP_IP 0x9C01 0x138D ADDRESS "192.168.1.50" /end XCP_ON_UDP_IP
 /begin XCP_ON_TCP_IP 0x7002 0x138D ADDRESS "192.168.1.50" /end XCP_ON_TCP_IP
/end IF_DATA
/begin MEASUREMENT V_AIN0_mV "" UWORD app_CM_uint16 0 0 0 65535 ECU_ADDRESS 0x10000268 /end MEASUREMENT
/begin MEASUREMENT V_AIN1_mV "" UWORD app_CM_uint16 0 0 0 65535 ECU_ADDRESS 0x10000266 /end MEASUREMENT
/begin MEASUREMENT V_AIN2_mV "" UWORD app_CM_uint16 0 0 0 65535 ECU_ADDRESS 0x10000264 /end MEASUREMENT
/begin MEASUREMENT V_AIN3_mV "" UWORD app_CM_uint16 0 0 0 65535 ECU_ADDRESS 0x10000262 /end MEASUREMENT
/begin MEASUREMENT app_B.CANPack.Data "" UBYTE app_CM_uint8 0 0 0 255 ECU_ADDRESS 0x0 LAYOUT COLUMN_DIR MATRIX_DIM 8 /end MEASUREMENT
/begin MEASUREMENT app_B.CANPack.Error "" UBYTE app_CM_uint8 0 0 0 255 ECU_ADDRESS 0x0 /end MEASUREMENT
/begin MEASUREMENT app_B.CANPack.Extended "" UBYTE app_CM_uint8 0 0 0 255 ECU_ADDRESS 0x0 /end MEASUREMENT
/begin MEASUREMENT app_B.CANPack.ID "" ULONG app_CM_uint32 0 0 0 4294967295 ECU_ADDRESS 0x0 /end MEASUREMENT
/begin MEASUREMENT app_B.CANPack.Length "" UBYTE app_CM_uint8 0 0 0 255 ECU_ADDRESS 0x0 /end MEASUREMENT
/begin MEASUREMENT app_B.CANPack.Remote "" UBYTE app_CM_uint8 0 0 0 255 ECU_ADDRESS 0x0 /end MEASUREMENT
/begin MEASUREMENT app_B.CANPack.Timestamp "" FLOAT64_IEEE app_CM_double 0 0 -1.7E+308 1.7E+308 ECU_ADDRESS 0x0 /end MEASUREMENT
/begin MEASUREMENT app_B.CANUnpack_o3 "" UBYTE app_CM_uint8 0 0 0 255 ECU_ADDRESS 0x0 /end MEASUREMENT
/begin MEASUREMENT app_B.CCaller_o1.Data "" UBYTE app_CM_uint8 0 0 0 255 ECU_ADDRESS 0x0 LAYOUT COLUMN_DIR MATRIX_DIM 8 /end MEASUREMENT
/begin MEASUREMENT app_B.CCaller_o1.Error "" UBYTE app_CM_uint8 0 0 0 255 ECU_ADDRESS 0x0 /end MEASUREMENT
/begin MEASUREMENT app_B.CCaller_o1.Extended "" UBYTE app_CM_uint8 0 0 0 255 ECU_ADDRESS 0x0 /end MEASUREMENT
/begin MEASUREMENT app_B.CCaller_o1.ID "" ULONG app_CM_uint32 0 0 0 4294967295 ECU_ADDRESS 0x0 /end MEASUREMENT
/begin MEASUREMENT app_B.CCaller_o1.Length "" UBYTE app_CM_uint8 0 0 0 255 ECU_ADDRESS 0x0 /end MEASUREMENT
/begin MEASUREMENT app_B.CCaller_o1.Remote "" UBYTE app_CM_uint8 0 0 0 255 ECU_ADDRESS 0x0 /end MEASUREMENT
/begin MEASUREMENT app_B.CCaller_o1.Timestamp "" FLOAT64_IEEE app_CM_double 0 0 -1.7E+308 1.7E+308 ECU_ADDRESS 0x0 /end MEASUREMENT
/begin MEASUREMENT app_DW.CANPack_ModeSignalID "" SLONG app_CM_int_T 0 0 -2147483648 2147483647 ECU_ADDRESS 0x0 /end MEASUREMENT
/begin MEASUREMENT app_DW.CANUnpack_ModeSignalID "" SLONG app_CM_int_T 0 0 -2147483648 2147483647 ECU_ADDRESS 0x0 /end MEASUREMENT
/begin MEASUREMENT app_DW.CANUnpack_StatusPortID "" SLONG app_CM_int_T 0 0 -2147483648 2147483647 ECU_ADDRESS 0x0 /end MEASUREMENT
/begin MEASUREMENT app_DW.clockTickCounter "" SLONG app_CM_int32 0 0 -2147483648 2147483647 ECU_ADDRESS 0x0 /end MEASUREMENT
/begin CHARACTERISTIC bLedState "" VALUE 0x10000038 Record_UBYTE 0 app_CM_uint8 0 255 /end CHARACTERISTIC
/begin MEASUREMENT byte0 "" UBYTE app_CM_uint8 0 0 0 255 ECU_ADDRESS 0x10000261 /end MEASUREMENT
/begin MEASUREMENT byte1 "" UBYTE app_CM_uint8 0 0 0 255 ECU_ADDRESS 0x10000260 /end MEASUREMENT
/begin COMPU_METHOD app_CM_double "Q = V" IDENTICAL "%15.10" "" /end COMPU_METHOD
/begin COMPU_METHOD app_CM_int32 "Q = V" IDENTICAL "%10.0" "" /end COMPU_METHOD
/begin COMPU_METHOD app_CM_int_T "Q = V" IDENTICAL "%0.6" "" /end COMPU_METHOD
/begin COMPU_METHOD app_CM_uint16 "Q = V" IDENTICAL "%5.0" "" /end COMPU_METHOD
/begin COMPU_METHOD app_CM_uint32 "Q = V" IDENTICAL "%10.0" "" /end COMPU_METHOD
/begin COMPU_METHOD app_CM_uint8 "Q = V" IDENTICAL "%3.0" "" /end COMPU_METHOD
/begin RECORD_LAYOUT Record_FLOAT64_IEEE FNC_VALUES 1 FLOAT64_IEEE COLUMN_DIR DIRECT /end RECORD_LAYOUT
/begin RECORD_LAYOUT Record_SLONG FNC_VALUES 1 SLONG COLUMN_DIR DIRECT /end RECORD_LAYOUT
/begin RECORD_LAYOUT Record_UBYTE FNC_VALUES 1 UBYTE COLUMN_DIR DIRECT /end RECORD_LAYOUT
/begin RECORD_LAYOUT Record_ULONG FNC_VALUES 1 ULONG COLUMN_DIR DIRECT /end RECORD_LAYOUT
/begin RECORD_LAYOUT Record_UWORD FNC_VALUES 1 UWORD COLUMN_DIR DIRECT /end RECORD_LAYOUT
/begin GROUP app "app" ROOT /begin REF_CHARACTERISTIC bLedState /end REF_CHARACTERISTIC
 /begin REF_MEASUREMENT app_B.CANUnpack_o3 app_DW.CANPack_ModeSignalID app_DW.CANUnpack_ModeSignalID app_DW.CANUnpack_StatusPortID app_DW.clockTickCounter byte0 byte1 /end REF_MEASUREMENT
 /begin SUB_GROUP app_AIN0 app_AIN1 app_AIN2 app_AIN3 app_B.CANPack app_B.CCaller_o1 /end SUB_GROUP
/end GROUP
/begin GROUP app_AIN0 "app/AIN0" /begin REF_MEASUREMENT V_AIN0_mV /end REF_MEASUREMENT /end GROUP
/begin GROUP app_AIN1 "app/AIN1" /begin REF_MEASUREMENT V_AIN1_mV /end REF_MEASUREMENT /end GROUP
/begin GROUP app_AIN2 "app/AIN2" /begin REF_MEASUREMENT V_AIN2_mV /end REF_MEASUREMENT /end GROUP
/begin GROUP app_AIN3 "app/AIN3" /begin REF_MEASUREMENT V_AIN3_mV /end REF_MEASUREMENT /end GROUP
/begin GROUP app_B.CANPack ""
 /begin REF_MEASUREMENT app_B.CANPack.Data app_B.CANPack.Error app_B.CANPack.Extended app_B.CANPack.ID app_B.CANPack.Length app_B.CANPack.Remote app_B.CANPack.Timestamp /end REF_MEASUREMENT
/end GROUP
/begin GROUP app_B.CCaller_o1 ""
 /begin REF_MEASUREMENT app_B.CCaller_o1.Data app_B.CCaller_o1.Error app_B.CCaller_o1.Extended app_B.CCaller_o1.ID app_B.CCaller_o1.Length app_B.CCaller_o1.Remote app_B.CCaller_o1.Timestamp /end REF_MEASUREMENT
/end GROUP
/end MODULE
/end PROJECT
