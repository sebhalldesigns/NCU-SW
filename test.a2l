/* generated by ASAP2 Studio 20.0.10.42 */ ASAP2_VERSION 1 71
/begin PROJECT MATLAB_UDP_Example "Minimal A2L compatible with XCP UDP Configuration block"
/begin HEADER "Test A2L for Simulink XCP UDP" /end HEADER
/begin MODULE ExampleModule "Demo Module"
/begin MOD_PAR "" VERSION "1.0" ADDR_EPK 0x0 EPK "EPK" /end MOD_PAR
/begin MOD_COMMON "" ALIGNMENT_BYTE 1 ALIGNMENT_WORD 1 ALIGNMENT_LONG 1 ALIGNMENT_FLOAT16_IEEE 1 ALIGNMENT_FLOAT32_IEEE 1 ALIGNMENT_FLOAT64_IEEE 1 ALIGNMENT_INT64 1 /end MOD_COMMON
/begin IF_DATA XCP
 /begin PROTOCOL_LAYER 0x0105 0x07D0 0x2710 0x00 0x00 0x00 0x00 0x00 0x08 0x08 BYTE_ORDER_MSB_LAST ADDRESS_GRANULARITY_BYTE OPTIONAL_CMD DOWNLOAD OPTIONAL_CMD SET_MTA /end PROTOCOL_LAYER
 /begin DAQ DYNAMIC 0x00 0x00 0x00 OPTIMISATION_TYPE_DEFAULT ADDRESS_EXTENSION_FREE IDENTIFICATION_FIELD_TYPE_RELATIVE_WORD_ALIGNED GRANULARITY_ODT_ENTRY_SIZE_DAQ_BYTE 0x04 OVERLOAD_INDICATION_EVENT PRESCALER_SUPPORTED /begin TIMESTAMP_SUPPORTED 0x01 SIZE_WORD UNIT_1MS /end TIMESTAMP_SUPPORTED /end DAQ
 /begin PAG 0x00 /end PAG
 /begin PGM PGM_MODE_ABSOLUTE 0x00 0x00 /end PGM
 /begin XCP_ON_UDP_IP 0x9C01 0x138D ADDRESS "192.168.1.50" /end XCP_ON_UDP_IP
/end IF_DATA
/begin MEASUREMENT bButtonState "" UBYTE app_CM_logical 0 0 0 1 ECU_ADDRESS 0x100001BC /end MEASUREMENT
/begin CHARACTERISTIC bLedState "" VALUE 0x10000004 Record_BOOLEAN 0 app_CM_logical 0 1 /end CHARACTERISTIC
/begin COMPU_METHOD app_CM_logical "Q = V" IDENTICAL "%1.0" "" /end COMPU_METHOD
/begin RECORD_LAYOUT Record_BOOLEAN FNC_VALUES 1 UBYTE COLUMN_DIR DIRECT /end RECORD_LAYOUT
/begin GROUP app "app" ROOT /begin REF_CHARACTERISTIC bLedState /end REF_CHARACTERISTIC /begin REF_MEASUREMENT bButtonState /end REF_MEASUREMENT /begin SUB_GROUP app_GPIO_Read app_GPIO_Write /end SUB_GROUP /end GROUP
/begin GROUP app_GPIO_Read "app/GPIO Read" /begin REF_MEASUREMENT bButtonState /end REF_MEASUREMENT /end GROUP
/begin GROUP app_GPIO_Write "app/GPIO Write" /begin REF_MEASUREMENT bButtonState /end REF_MEASUREMENT /end GROUP
/end MODULE
/end PROJECT
